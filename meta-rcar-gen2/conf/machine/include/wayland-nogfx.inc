## meta-rcar-gen2/conf/machine/include/wayland-nogfx.inc
```bitbake
WAYLAND_GFX_ENABLE ?= "0"

BBMASK .= "|libegl|libgbm|wayland-kms|wayland-wsegl"
BBMASK .= "|meta-renesas/meta-rcar-gen2/recipes-graphics/mesa"
BBMASK .= "|meta-renesas/meta-rcar-gen2/recipes-graphics/cogl"
BBMASK .= "|meta-renesas-proprietary/meta-rcar-gen2-proprietary/recipes-graphics/wayland"
```

## meta-rcar-gen2/conf/machine/koelsch.conf
```bitbake
#@TYPE: Machine
#@NAME: koelsch
#@DESCRIPTION: Machine configuration for koelsch systems

require conf/machine/include/r8a7791.inc
require conf/machine/include/rcar-gen2-providers.inc

MACHINE_EXTRA_RRECOMMENDS = " kernel-modules"
DEFAULTTUNE = "cortexa15hf-neon"

IMAGE_FSTYPES += "tar.bz2"

SERIAL_CONSOLE = "38400 ttySC6"

KERNEL_DEVICETREE = "${S}/arch/arm/boot/dts/r8a7791-koelsch.dts"

UBOOT_MACHINE = "koelsch_config"

# koelsch depends version 2.4.45 of libdrm
PREFERRED_VERSION_libdrm = "2.4.45%"

# koelsch multimedia acceleration uses Gst version 1.2.x
PREFERRED_VERSION_gstreamer1.0              = "1.2.%"
PREFERRED_VERSION_gstreamer1.0-plugins-bad  = "1.2.%"
PREFERRED_VERSION_gstreamer1.0-plugins-base = "1.2.%"
PREFERRED_VERSION_gstreamer1.0-plugins-good = "1.2.%"
PREFERRED_VERSION_gstreamer1.0-plugins-ugly = "1.2.%"
PREFERRED_VERSION_gstreamer1.0-libav        = "1.2.%"
```
